#include "Temp.h"
#include "..\main\port.h"
#include "..\main\ext_reg.h"
#include <intrins.h>			     

/*Define ADC operation const for ADC_CONTR*/
#define ADC_POWER   0x80            //ADC power control bit
#define ADC_FLAG    0x10            //ADC complete flag
#define ADC_START   0x08            //ADC start control bit
#define ADC_SPEEDLL 0x00            //420 clocks
#define ADC_SPEEDL  0x20            //280 clocks
#define ADC_SPEEDH  0x40            //140 clocks
#define ADC_SPEEDHH 0x60            //70 clocks	 

							  
uint code Temp[130]={
		    44, 47, 50, 53, 56, 59, 62, 65, 69, 72,	 //-11~-20			10
		    76, 80, 84, 89, 93, 98,102,112,118,123,   //-1~-10			20
           129,135,142,148,154,160,167,174,182,189,	   //0~9			30
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		   899,899,901,902,904,905,906,907,908,910     //100~109
		   };

uint code HTG_Temp[130]={
		   958,955,952,948,945,942,938,934,930,926,	 //-20~-11			10
		   922,918,913,909,904,899,894,889,884,879,   //-10~-1			20
           873,868,862,856,850,844,838,831,825,818,	   //0~9			30
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		   176,172,168,165,161,158,155,151,148,145     //100~109
		   };  

uint code H_Temp[130]={
            29, 30, 32, 33, 35, 37, 38, 40, 42, 44,	   //0~9			10
		    46, 48, 51, 53, 55, 58, 60, 63, 66, 69,    //10~19     		20
   		    72, 75, 78, 81, 85, 88, 92, 95, 99,103,	   //20~29		    30
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		   742,748,753,759,763,770,775,780,785,790	   //120~129
		   };
		   
uint code THG_Humi[100] = {							  // 上拉4.7K 湿度 
           190,200,210,225,231,236,242,247,253,259,		  // 0 -- 10
           265,270,276,281,287,292,297,303,308,313,		  // 10 -- 19
		   319,324,330,335,340,346,351,356,362,367,		  // 20 -- 29
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		   695,700,706,711,716,722,727,733,738,744		  // 90 -- 100	
		   }; 	  
		   	   																	  		    
				
void Temp_Init()
{  	
	uchar i;		
	P1ASF = 0xff;                   // 1111 1110, 		 
	ADC_CONTR = ADC_POWER | ADC_SPEEDLL;
	for(i=0;i<50;i++){ NOP(); }		 
}
 
void Temp_Update()
{
	uint AD_data;

	AD_data = 1024 - AD_Transform(0);					 //室外温度
	Outdoor_Temperature = AD_Temp(AD_data,2)+ m_Param[4] - 148;

	AD_data = AD_Transform(1);
	Outdoor_Humidity =  AD_data/6.144 + m_Param[4] - 128;//室外湿度

	AD_data = AD_Transform(3);
	if(AD_data > 50)	{Supply_Pump =1;}
	else	{Supply_Pump =0;}

	AD_data = 1024 - AD_Transform(4);  				     //水箱温度
	Water_Temperature = AD_Temp(AD_data,2) + m_Param[2] - 148; 

	AD_data = AD_Transform(5) ;				             //水位高度
	Tem_data[1] = AD_data/34 + m_Param[3] - 128;
} 

uint  AD_Transform(char ch)
{
	uint i;
	uint tmp_Temp=0; 
	
	ADC_CONTR = ADC_POWER | ADC_SPEEDLL | ch | ADC_START; 
	for(i=0;i<10;i++){NOP();} 
	// 启动A/D转换, 
	while (!(ADC_CONTR & ADC_FLAG));//Wait complete flag   等待完成标志
	ADC_CONTR &= ~ADC_FLAG;         //Close ADC
	
	tmp_Temp = ADC_RES;		   
	tmp_Temp = tmp_Temp<<2;
	tmp_Temp = tmp_Temp|(ADC_RESL&0x03);
	if (tmp_Temp<10){tmp_Temp=0;}
	
	return 	tmp_Temp;
}
  	
uchar AD_Temp(uint m_data,uchar x)
{
	uchar max=130 ,min = 1,mid;
	
	if(m_data<43)
	{
		min=0xff;
		return min;
	}
	
	while(min <= max)
	{ 
		mid = (max + min) / 2;
		switch(x)
		{
			case  0:
				if(m_data > Temp[mid]){min = mid + 1;} 
				else { max = mid - 1;}
			break;
		
			case  1:
				if(m_data > H_Temp[mid]){min = mid + 1;} 
				else { max = mid - 1;}
				if(min<8) {min=8;}
			break;
			
			case  2:
				if(m_data > (1024-HTG_Temp[mid])){min = mid + 1;} 
				else { max = mid - 1;}
			break;
			
			case  3:
				if(m_data > THG_Humi[mid]){min = mid + 1;} 
				else { max = mid - 1;}
			break;  			
		}       
	}    	
	return min;     
}
							  